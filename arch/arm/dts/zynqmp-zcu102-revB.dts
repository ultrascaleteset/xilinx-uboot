/*modified
 * dts file for Xilinx ZynqMP ZCU102 RevB
 *
 * (C) Copyright 2016, Xilinx, Inc.
 *
 * Michal Simek <michal.simek@xilinx.com>
 *
 * SPDX-License-Identifier:	GPL-2.0+
 */

#include "zynqmp-zcu102-revA.dts"

/ {
	model = "ZynqMP ZCU102 RevB";
	compatible = "xlnx,zynqmp-zcu102-revB", "xlnx,zynqmp-zcu102", "xlnx,zynqmp";
};




