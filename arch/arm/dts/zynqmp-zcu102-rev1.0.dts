/*
 * dts file for Xilinx ZynqMP ZCU102 Rev1.0
 *
 * (C) Copyright 2016, Xilinx, Inc.
 *
 * Michal Simek <michal.simek@xilinx.com>
 *
 * SPDX-License-Identifier:	GPL-2.0+
 */

#include "zynqmp-zcu102-revB.dts"

/ {
	model = "ZynqMP ZCU102 Rev1.0";
	compatible = "xlnx,zynqmp-zcu102-rev1.0", "xlnx,zynqmp-zcu102", "xlnx,zynqmp";
};


